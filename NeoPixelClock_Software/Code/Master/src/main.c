/*
******************************************************************************
File:     main.c
Info:     Generated by Atollic TrueSTUDIO(R) 7.1.0   2017-03-01

The MIT License (MIT)
Copyright (c) 2009-2017 Atollic AB

Permission is hereby granted, free of charge, to any person obtaining a copy
of this software and associated documentation files (the "Software"), to deal
in the Software without restriction, including without limitation the rights
to use, copy, modify, merge, publish, distribute, sublicense, and/or sell
copies of the Software, and to permit persons to whom the Software is
furnished to do so, subject to the following conditions:

The above copyright notice and this permission notice shall be included in all
copies or substantial portions of the Software.

THE SOFTWARE IS PROVIDED "AS IS", WITHOUT WARRANTY OF ANY KIND, EXPRESS OR
IMPLIED, INCLUDING BUT NOT LIMITED TO THE WARRANTIES OF MERCHANTABILITY,
FITNESS FOR A PARTICULAR PURPOSE AND NONINFRINGEMENT. IN NO EVENT SHALL THE
AUTHORS OR COPYRIGHT HOLDERS BE LIABLE FOR ANY CLAIM, DAMAGES OR OTHER
LIABILITY, WHETHER IN AN ACTION OF CONTRACT, TORT OR OTHERWISE, ARISING FROM,
OUT OF OR IN CONNECTION WITH THE SOFTWARE OR THE USE OR OTHER DEALINGS IN THE
SOFTWARE.

******************************************************************************
*/

/* Includes */
#include "../Libraries/NPC/Framework/inc/NPC_configuration.h"
#include "../Libraries/NPC/UnitTest/inc/clock_management_test.h"

//#include "stm32f4xx.h"
/* Private macro */
/* Private variables */
/* Private function prototypes */
/* Private functions */

/**
**===========================================================================
**
**  Abstract: main program
**
**===========================================================================
*/
int main(void)
{
  int i = 0;
  int32_t temp = 0;
  uint32_t color = 0;
  /**
  *  IMPORTANT NOTE!
  *  The symbol VECT_TAB_SRAM needs to be defined when building the project
  *  if code has been located to RAM and interrupts are used. 
  *  Otherwise the interrupt table located in flash will be used.
  *  See also the <system_*.c> file and how the SystemInit() function updates 
  *  SCB->VTOR register.  
  *  E.g.  SCB->VTOR = 0x20000000;  
  */

  /* TODO - Add your application code here */
 /* bluetooth_init();
  GPIO_WriteBit(GPIOD,GPIO_Pin_13,Bit_SET);*/
  /* Infinite loop */
  NPC_init();

/*
  bool time_comp = test_ClockMangement_time_comparison();
  bool date_comp = test_ClockMangement_date_comparison();
  bool alarm_comp = test_ClockMangement_alarm_comparison();
 */
  bool time_save_load = test_ClockMangement_save_and_load_time();
  bool date_save_load = test_ClockMangement_save_and_load_date();
  bool alarm_save_load = test_ClockMangement_save_and_load_alarm();
  neopixel_setBrightness(100);
  while (1)
  {
	i++;
	temp = temperature_read();
	switch(pixel_color){
	case 'R': color = neopixel_colourRGB(255,0,0); break;
	case 'G': color = neopixel_colourRGB(0,255,0); break;
	case 'B': color = neopixel_colourRGB(0,0,255); break;
	case 'Y': color = neopixel_colourRGB(255,255,0); break;
	case 'C': color = neopixel_colourRGB(0,255,255); break;
	case 'M': color = neopixel_colourRGB(255,0,255); break;
	case 'W': color = neopixel_colourRGB(255,255,255); break;
	case 'D': color = neopixel_colourRGB(0,0,0); break;
	}
	int j=150000;
	while(j)j--;
	neopixel_setPixelColour((i-1)%4,0);
	neopixel_setPixelColour(i%4,color);
  }
}

/*
 * Callback used by stm32f4_discovery_audio_codec.c.
 * Refer to stm32f4_discovery_audio_codec.h for more info.
 */
void EVAL_AUDIO_TransferComplete_CallBack(uint32_t pBuffer, uint32_t Size){
  /* TODO, implement your code here */
  return;
}

/*
 * Callback used by stm324xg_eval_audio_codec.c.
 * Refer to stm324xg_eval_audio_codec.h for more info.
 */
uint16_t EVAL_AUDIO_GetSampleCallBack(void){
  /* TODO, implement your code here */
  return -1;
}
